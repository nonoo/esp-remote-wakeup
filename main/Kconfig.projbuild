## main/Kconfig.projbuild
```kconfig
menu "ESP Wakeup Keypress"

    config ESP_WAKEUP_KEYPRESS_WIFI_SSID
        depends on !EXAMPLE_WIFI_SSID_PWD_FROM_STDIN
        string "WiFi SSID"
        default "ssid"
        help
            SSID (network name) to connect to.

    config ESP_WAKEUP_KEYPRESS_WIFI_PASSWORD
        string "Wi-Fi Password"
        default "password"
        help
            Wi-Fi password to use.
            Can be left blank if the network has no security set.

    config ESP_WAKEUP_KEYPRESS_HTTPD_PASSWORD
        string "HTTPD password"
        default "wakeup"
        help
            Password for HTTP server authentication in the query URL.

    config ESP_WAKEUP_KEYPRESS_LED_STRIP_GPIO_NUM
        int "LED strip GPIO num"
        default 48
        help
            GPIO number of RMT LED strip on the devboard

endmenu
```

## sdkconfig.defaults
```kconfig
CONFIG_SDK_TOOLPREFIX="xtensa-esp32s3-elf-"
CONFIG_TOOLPREFIX="xtensa-esp32s3-elf-"
CONFIG_ESPTOOLPY_FLASHMODE_QIO=y
CONFIG_ESPTOOLPY_FLASHSIZE_8MB=y
CONFIG_ESPTOOLPY_FLASHSIZE="8MB"
CONFIG_ESPTOOLPY_FLASHSIZE_DETECT=y
CONFIG_ESP_DEFAULT_CPU_FREQ_MHZ_240=y
CONFIG_ESP_DEFAULT_CPU_FREQ_MHZ=240
CONFIG_ETH_ENABLED=n
CONFIG_ETH_USE_SPI_ETHERNET=n
CONFIG_ESP_HTTP_CLIENT_ENABLE_HTTPS=n
CONFIG_ESP_WIFI_TASK_PINNED_TO_CORE_0=y
CONFIG_LWIP_LOCAL_HOSTNAME="esp-wakeup-keypress"
CONFIG_LWIP_TCP_SYNMAXRTX=3
CONFIG_LWIP_TCPIP_CORE_LOCKING=y
CONFIG_LWIP_TCPIP_TASK_AFFINITY_CPU0=y
CONFIG_LWIP_TCPIP_TASK_AFFINITY=0x0
CONFIG_LWIP_IPV6_AUTOCONFIG=y
CONFIG_LWIP_IPV6_NUM_ADDRESSES=3
CONFIG_LWIP_IPV6_RDNSS_MAX_DNS_SERVERS=2
CONFIG_LWIP_ESP_LWIP_ASSERT=y
CONFIG_MQTT_PROTOCOL_311=n
CONFIG_MQTT_TRANSPORT_SSL=n
CONFIG_MQTT_TRANSPORT_WEBSOCKET=n
CONFIG_MQTT_TRANSPORT_WEBSOCKET_SECURE=n
CONFIG_NEWLIB_STDOUT_LINE_ENDING_CRLF=y
CONFIG_NEWLIB_STDIN_LINE_ENDING_LF=y
CONFIG_NEWLIB_NANO_FORMAT=y
CONFIG_PTHREAD_DEFAULT_CORE_0=y
CONFIG_PTHREAD_DEFAULT_CORE_NO_AFFINITY=n
CONFIG_PTHREAD_TASK_CORE_DEFAULT=0
CONFIG_SPIFFS_CACHE=n
CONFIG_SPIFFS_CACHE_WR=n
CONFIG_SPIFFS_PAGE_CHECK=n
CONFIG_SPIFFS_USE_MAGIC=n
CONFIG_SPIFFS_USE_MTIME=n
CONFIG_WS_TRANSPORT=n
CONFIG_UNITY_ENABLE_FLOAT=n
CONFIG_UNITY_ENABLE_DOUBLE=n
CONFIG_UNITY_ENABLE_IDF_TEST_RUNNER=n
CONFIG_VFS_SUPPORT_DIR=n
CONFIG_VFS_SUPPORT_TERMIOS=n
CONFIG_MB_CONTROLLER_SLAVE_ID_SUPPORT=n
CONFIG_FMB_COMM_MODE_RTU_EN=n
CONFIG_FMB_COMM_MODE_ASCII_EN=n
CONFIG_PM_ENABLE=y
CONFIG_PM_POWER_DOWN_CPU_IN_LIGHT_SLEEP=n
CONFIG_LOG_DEFAULT_LEVEL_WARN=y
CONFIG_LOG_DEFAULT_LEVEL=2
CONFIG_LOG_MAXIMUM_LEVEL=2
CONFIG_BOOTLOADER_LOG_LEVEL_WARN=y
CONFIG_BOOTLOADER_LOG_LEVEL=2
CONFIG_FREERTOS_ENABLE_TASK_SNAPSHOT=y
CONFIG_FREERTOS_VTASKLIST_INCLUDE_COREID=y
CONFIG_FREERTOS_GENERATE_RUN_TIME_STATS=y

CONFIG_SPIRAM=y
CONFIG_SPIRAM_SPEED_80M=y
CONFIG_SPIRAM_SPEED=80
CONFIG_SPIRAM_IGNORE_NOTFOUND=y
CONFIG_SPIRAM_USE_CAPS_ALLOC=y
CONFIG_SPIRAM_MEMTEST=n
CONFIG_SPIRAM_TRY_ALLOCATE_WIFI_LWIP=y

CONFIG_TINYUSB_HID_COUNT=1

# Debug stuff
CONFIG_COMPILER_STACK_CHECK_MODE_ALL=y
CONFIG_COMPILER_STACK_CHECK=y
CONFIG_COMPILER_WARN_WRITE_STRINGS=y
CONFIG_FREERTOS_WATCHPOINT_END_OF_STACK=y
CONFIG_FREERTOS_USE_TRACE_FACILITY=y
CONFIG_FREERTOS_USE_STATS_FORMATTING_FUNCTIONS=y
CONFIG_FREERTOS_RUN_TIME_STATS_USING_ESP_TIMER=y
CONFIG_HEAP_POISONING_LIGHT=y
CONFIG_LOG_MAXIMUM_LEVEL_VERBOSE=y
CONFIG_LOG_MAXIMUM_LEVEL=5
```
